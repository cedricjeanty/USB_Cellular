## esp32/sdkconfig.defaults
```kconfig
# AirBridge ESP32-S3 — ESP-IDF sdkconfig
# Board: ESP32-S3-DevKitC-1 (4 MB flash, 2 MB PSRAM)

# Flash
CONFIG_ESPTOOLPY_FLASHSIZE_4MB=y
CONFIG_ESPTOOLPY_FLASHMODE_DIO=y

# PSRAM — disabled (octal PSRAM init fails on this board variant)
# CONFIG_SPIRAM is not set

# FreeRTOS
CONFIG_FREERTOS_HZ=1000

# ── Upload throughput tuning ─────────────────────────────────────
# TCP send buffer & window: default 5760 caps HTTPS upload at ~94 KB/s
CONFIG_LWIP_TCP_SND_BUF_DEFAULT=32768
CONFIG_LWIP_TCP_WND_DEFAULT=32768
CONFIG_LWIP_TCP_RECVMBOX_SIZE=32

# mbedTLS: asymmetric buffers — tuned for CDC+MSC heap constraints
CONFIG_MBEDTLS_ASYMMETRIC_CONTENT_LEN=y
CONFIG_MBEDTLS_SSL_OUT_CONTENT_LEN=8192
CONFIG_MBEDTLS_SSL_IN_CONTENT_LEN=8192

# TLS: skip server cert verification (same as Arduino setInsecure)
CONFIG_ESP_TLS_INSECURE=y
CONFIG_ESP_TLS_SKIP_SERVER_CERT_VERIFY=y

# Hardware crypto accelerators
CONFIG_MBEDTLS_HARDWARE_AES=y
CONFIG_MBEDTLS_HARDWARE_SHA=y
CONFIG_MBEDTLS_HARDWARE_MPI=y

# ── USB ──────────────────────────────────────────────────────────
CONFIG_TINYUSB_ENABLED=y
CONFIG_TINYUSB_MSC_ENABLED=y
CONFIG_TINYUSB_CDC_ENABLED=y

# Present as a generic USB mass storage device for avionics compatibility
CONFIG_TINYUSB_DESC_USE_ESPRESSIF_VID=n
CONFIG_TINYUSB_DESC_CUSTOM_VID=0x1209
CONFIG_TINYUSB_DESC_USE_DEFAULT_PID=n
CONFIG_TINYUSB_DESC_CUSTOM_PID=0x0001
CONFIG_TINYUSB_DESC_MANUFACTURER_STRING="AirBridge"
CONFIG_TINYUSB_DESC_PRODUCT_STRING="USB Storage"
CONFIG_TINYUSB_DESC_SERIAL_STRING="AB0001"
CONFIG_TINYUSB_DESC_MSC_STRING="Mass Storage"
CONFIG_TINYUSB_DESC_CDC_STRING="Serial Port"

# ── FAT filesystem ──────────────────────────────────────────────
CONFIG_FATFS_LFN_HEAP=y
# SD card uses 512-byte sectors (default 4096 breaks MBR parsing)
CONFIG_FATFS_SECTOR_4096=n
CONFIG_FATFS_SECTOR_512=y
CONFIG_FATFS_MAX_LFN=255
CONFIG_FATFS_API_ENCODING_UTF_8=y
CONFIG_FATFS_CODEPAGE_850=y

# ── WiFi ─────────────────────────────────────────────────────────
CONFIG_ESP_WIFI_STATIC_RX_BUFFER_NUM=8
CONFIG_ESP_WIFI_DYNAMIC_RX_BUFFER_NUM=32
CONFIG_ESP_WIFI_STATIC_TX_BUFFER_NUM=8

# ── Watchdog ─────────────────────────────────────────────────────
CONFIG_ESP_TASK_WDT_TIMEOUT_S=30

# ── Cellular modem (PPP over Serial) ────────────────────────────
CONFIG_LWIP_PPP_SUPPORT=y
CONFIG_LWIP_PPP_PAP_SUPPORT=y
CONFIG_LWIP_PPP_NOTIFY_PHASE_SUPPORT=y
# Disable IPv6 over PPP — many carriers reject IPv6CP, causing PPP termination
CONFIG_LWIP_PPP_ENABLE_IPV6=n
# Enable LCP echo keepalives (detect dead links faster)
CONFIG_LWIP_ENABLE_LCP_ECHO=y
CONFIG_LWIP_LCP_ECHOINTERVAL=30
CONFIG_LWIP_LCP_MAXECHOFAILS=3
# PPP debug — see LCP/IPCP negotiation details
CONFIG_LWIP_PPP_DEBUG_ON=y

# Redirect console from UART0 (GPIO 43/44) to USB Serial JTAG
# so UART pins are free for SIM7600 modem
CONFIG_ESP_CONSOLE_USB_SERIAL_JTAG=y

# ── Partition table ──────────────────────────────────────────────
CONFIG_PARTITION_TABLE_CUSTOM=y
CONFIG_PARTITION_TABLE_CUSTOM_FILENAME="partitions.csv"
```
